## config/west.yml
```yaml
# Default
# manifest:
#   remotes:
#     - name: zmkfirmware
#       url-base: https://github.com/zmkfirmware
#   projects:
#     - name: zmk
#       remote: zmkfirmware
#       revision: main
#       import: app/west.yml
#   self:
#     path: config

# manifest:
manifest:
  remotes:
    - name: infused-kim
      url-base: https://github.com/infused-kim
  projects:
    - name: zmk
      remote: infused-kim
      revision: sofle
      import: app/west.yml
  self:
    path: config
```
